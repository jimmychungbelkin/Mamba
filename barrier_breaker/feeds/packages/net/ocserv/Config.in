## barrier_breaker/feeds/packages/net/ocserv/Config.in
```kconfig
# ocserv avanced configuration

menu "Configuration"
	depends on PACKAGE_ocserv

config OCSERV_PAM
	bool "enable PAM"
	default n

config OCSERV_DBUS
	bool "enable DBUS (needed for occtl)"
	default n

endmenu
```
